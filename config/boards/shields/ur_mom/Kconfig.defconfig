## config/boards/shields/ur_mom/Kconfig.defconfig
```kconfig
if SHIELD_UR_MOM_LEFT

config ZMK_KEYBOARD_NAME
	default "ur mom left"

config ZMK_SPLIT_BLE_ROLE_CENTRAL
	default y

endif

if SHIELD_UR_MOM_LEFT || SHIELD_UR_MOM_RIGHT

config ZMK_SPLIT
	default y
	
endif
```

## config/boards/shields/ur_mom/Kconfig.shield
```kconfig
config SHIELD_UR_MOM_LEFT
	def_bool $(shields_list_contains,ur_mom_left)

config SHIELD_UR_MOM_RIGHT
	def_bool $(shields_list_contains,ur_mom_right)
```
